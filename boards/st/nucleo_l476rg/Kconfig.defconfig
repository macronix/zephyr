## drivers/flash/Kconfig.nand
```kconfig
# Copyright (c) 2025 Embeint Pty Ltd
#
# SPDX-License-Identifier: Apache-2.0

menuconfig SPI_NAND
	bool "SPI NAND Flash"
	default y
	depends on DT_HAS_JEDEC_SPI_NAND_ENABLED
	select FLASH_HAS_DRIVER_ENABLED
	select FLASH_HAS_EXPLICIT_ERASE
	select FLASH_HAS_PAGE_LAYOUT
	select FLASH_HAS_EX_OP
	select SPI
	select CRC

if SPI_NAND

config SPI_NAND_INIT_PRIORITY
	int "Init priority"
	default 80
	help
	  Device driver initialization priority. Device is connected to
	  SPI bus, it has to be initialized after SPI driver.

config SPI_NAND_SOFTWARE_ECC
	bool "Software ECC for SPI NAND flash"
	help
	  Enable this option to use software-based ECC (Error Correction Code)
	  when accessing SPI NAND flash devices. This is useful for platforms
	  that do not support hardware ECC, or when additional software control
	  over ECC handling is required.

config SPI_NAND_ECC_STEP_SIZE
	int "ECC step size (bytes)"
	default 512
	depends on SPI_NAND_SOFTWARE_ECC
	help
	  Specifies the ECC (Error Correction Code) step size in bytes for SPI NAND
	  flash operations. This value determines how many bytes of data are protected
	  by one ECC block.

endif # SPI_NAND
```

## drivers/mspi/Kconfig.xlnx
```kconfig
#Copyright (c) 2025-2026 Macronix International Co., Ltd.
#SPDX-License-Identifier: Apache-2.0

config MSPI_XLNX
	bool "Xilix MSPI controller driver"
	default y
```

## drivers/spi/Kconfig.mxic
```kconfig
# Copyright (c) 2025-2026 Macronix International Co., Ltd.
# SPDX-License-Identifier: Apache-2.0

menuconfig SPI_MXIC_UEFC
	bool "MXIC UEFC SPI controller driver"
	default y
	depends on DT_HAS_XLNX_MXIC_UEFC_SPI_ENABLED
	help
	  Enable the Macronix UEFC host controller driver for the standard
	  SPI subsystem (PIO/IO transfer mode only).
```

## dts/bindings/mspi/mspi-mxic-controller.yaml
```yaml
#Copyright (c) 2025-2026 Macronix International Co., Ltd.
#SPDX-License-Identifier: Apache-2.0

description: xlnx uefc MSPI controller

bus: mspi

compatible: "mspi-mxic-controller"

include: [mspi-controller.yaml, pinctrl-device.yaml]

properties:
  reg:
    required: true
  clock-frequency:
    type: int
    description: |
      Clock frequency the SPI peripheral is being driven at, in Hz.
  "#address-cells":
    required: true
    const: 1
  "#size-cells":
    required: true
    const: 1
```

## dts/bindings/mspi/xlnx,mspi-controller.yaml
```yaml
# Copyright (c) 2018, I-SENSE group of ICCS
# SPDX-License-Identifier: Apache-2.0

description: xlnx uefc MSPI controller

bus: mspi

compatible: "xlnx,mspi-controller"

include: [mspi-controller.yaml, pinctrl-device.yaml]

properties:
  reg:
    required: true
  clock-frequency:
    type: int
    description: |
      Clock frequency the SPI peripheral is being driven at, in Hz.
  "#address-cells":
    required: true
    const: 1
  "#size-cells":
    required: true
    const: 0
```

## dts/bindings/spi/xlnx,mxic-uefc-spi.yaml
```yaml
# Copyright (c) 2018, I-SENSE group of ICCS
# SPDX-License-Identifier: Apache-2.0

description: xlnx uefc SPI controller

bus: spi

compatible: "xlnx,mxic-uefc-spi"

include: base.yaml

properties:
  reg:
    required: true
  clock-frequency:
    type: int
    description: |
      Clock frequency the SPI peripheral is being driven at, in Hz.
  "#address-cells":
    required: true
    const: 1
  "#size-cells":
    required: true
    const: 0
```

## samples/drivers/mspi/mspi_flash/boards/zybo.conf
```kconfig
CONFIG_MAIN_STACK_SIZE=8192
CONFIG_LOG=y
CONFIG_LOG_DEFAULT_LEVEL=3
CONFIG_MSPI_INIT_PRIORITY=40
CONFIG_FLASH_INIT_PRIORITY=50
CONFIG_MSPI_XIP=y
CONFIG_HEAP_MEM_POOL_SIZE=32768
CONFIG_ARM_MPU=n
CONFIG_ARM_AARCH32_MMU=n
CONFIG_RISCV_PMP=n
CONFIG_ARC_MPU_ENABLE=n
```
